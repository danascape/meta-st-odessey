## conf/layer.conf
```bitbake
# We have a conf and classes directory, add to BBPATH
BBPATH .= ":${LAYERDIR}"

# We have recipes-* directories, add to BBFILES
BBFILES += "${LAYERDIR}/recipes-*/*/*.bb \
            ${LAYERDIR}/recipes-*/*/*.bbappend"

BBFILE_COLLECTIONS += "meta-st-odessey"
BBFILE_PATTERN_meta-st-odessey = "^${LAYERDIR}/"
BBFILE_PRIORITY_meta-st-odessey = "6"

LAYERDEPENDS_meta-st-odessey = "core"
LAYERSERIES_COMPAT_meta-st-odessey = "mickledore"

LAYERDEPENDS_meta-st-odessey = "core openembedded-layer"
```
